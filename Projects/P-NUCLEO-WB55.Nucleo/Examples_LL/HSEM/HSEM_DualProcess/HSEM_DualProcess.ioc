# file: HSEM_DualProcess.ioc
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Mcu.Family=STM32WB
Mcu.Name=STM32WB55RGVx
Mcu.Package=VFQFPN68
NVIC.PriorityGroup=NVIC_PRIORITYGROUP_4
PB0.GPIO_Label=LED2
PB0.GPIO_PuPd=GPIO_NOPULL
PB0.Signal=GPIO_Output
ProjectManager.HeapSize=0x200
ProjectManager.StackSize=0x400
ProjectManager.TargetToolchain=EWARM V8
RCC.ADCFreq_Value=16000000
RCC.AHB2CLKDivider=RCC_SYSCLK_DIV2
RCC.AHBFreq_Value=16000000
RCC.APB1Freq_Value=16000000
RCC.APB1TimFreq_Value=16000000
RCC.APB2Freq_Value=16000000
RCC.APB2TimFreq_Value=16000000
RCC.APB3Freq_Value=16000000
RCC.CodegenConfigPeriph=false
RCC.CortexFreq_Value=16000000
RCC.HCLKFreq_Value=16000000
RCC.HSE_VALUE=8000000
RCC.HSI48_VALUE=48000000
RCC.HSI_VALUE=16000000
RCC.LSE_VALUE=32768
RCC.PLLN=32
RCC.SYSCLKFreq_VALUE=16000000
RCC.SYSCLKSource=RCC_SYSCLKSOURCE_HSI
RCC.USBFreq_Value=16000000
RCC.VCOOutputFreq_Value=128000000
board=custom

// file: Src/main.c
/* USER CODE BEGIN Header */
/**
  ******************************************************************************
  * @file    Examples_LL/HSEM/HSEM_DualProcess/Src/main.c
  * @author  MCD Application Team
  * @brief   This example describes how to use HSEM peripheral to lock and unlock
  *          hardware semaphore in the context of two process accessing the same
  *          semaphore using the STM32WBxx HSEM LL API.
  *          Peripheral initialization done using LL unitary services functions.
  ******************************************************************************
  * @attention
  *
  * <h2><center>&copy; Copyright (c) 2019 STMicroelectronics.
  * All rights reserved.</center></h2>
  *
  * This software component is licensed by ST under BSD 3-Clause license,
  * the "License"; You may not use this file except in compliance with the
  * License. You may obtain a copy of the License at:
  *                        opensource.org/licenses/BSD-3-Clause
  *
  ******************************************************************************
  */
/* USER CODE END Header */

#include "main.h"

void SystemClock_Config(void);
static void MX_GPIO_Init(void);
/* USER CODE BEGIN PFP */

void     Configure_HSEM(void);
void     LED_On(void);
void     LED_Blinking(uint32_t Period);

/* USER CODE END PFP */

int main(void)
{
  /* USER CODE BEGIN 1 */

  uint32_t lockStatus = 0;
  uint32_t currentProcess = 0;
  uint32_t currentCore = 0;

  /* USER CODE END 1 */

  /* MCU Configuration--------------------------------------------------------*/

  /* Reset of all peripherals, Initializes the Flash interface and the Systick. */

  NVIC_SetPriorityGrouping(NVIC_PRIORITYGROUP_4);

  /* System interrupt init*/

  /* Configure the system clock */
  SystemClock_Config();

  /* Initialize all configured peripherals */
  MX_GPIO_Init();
  /* USER CODE BEGIN 2 */

  /* Configure HSEM */
  Configure_HSEM();

  /* PROCESS_A takes the semaphore with success */
  lockStatus = LL_HSEM_2StepLock(HSEM, SEMAPHORE_ID, PROCESS_A);
  if(lockStatus != 0)
  {
    LED_Blinking(LED_BLINK_ERROR);
  }

  /* PROCESS_B takes the semaphore and fail (as already taken by PROCESS_A) */
  lockStatus = LL_HSEM_2StepLock(HSEM, SEMAPHORE_ID, PROCESS_B);
  if(lockStatus != 1)
  {
    LED_Blinking(LED_BLINK_ERROR);
  }

  /* PROCESS_B releases the semaphore and fail (as owned by PROCESS_A) */
  LL_HSEM_ReleaseLock(HSEM, SEMAPHORE_ID, PROCESS_B);

  /* The status of the semaphore is observed using LL_HSEM_GetStatus */
  lockStatus = LL_HSEM_GetStatus(HSEM, SEMAPHORE_ID);
  if(lockStatus != 1)
  {
    LED_Blinking(LED_BLINK_ERROR);
  }

  /* The current process locking the semaphore is observed using LL_HSEM_GetProcessId */
  currentProcess = LL_HSEM_GetProcessId(HSEM, SEMAPHORE_ID);
  if(currentProcess != PROCESS_A)
  {
    LED_Blinking(LED_BLINK_ERROR);
  }

  /* In multicore environment, the current core locking the semaphore is observed using LL_HSEM_GetCoreId */
  /* In this example, only one core is used and so only possible values are LL_HSEM_COREID_NONE or LL_HSEM_COREID_CPU1 */
  currentCore = LL_HSEM_GetCoreId(HSEM, SEMAPHORE_ID);
  if(currentCore != LL_HSEM_COREID_CPU1)
  {
    LED_Blinking(LED_BLINK_ERROR);
  }

  /* PROCESS_A releases the semaphore with success */
  LL_HSEM_ReleaseLock(HSEM, SEMAPHORE_ID, PROCESS_A);

  /* The status of the semaphore is observed using LL_HSEM_GetStatus */
  lockStatus = LL_HSEM_GetStatus(HSEM, SEMAPHORE_ID);
  if(lockStatus != 0)
  {
    LED_Blinking(LED_BLINK_ERROR);
  }

  LED_On();

  /* USER CODE END 2 */

  /* Infinite loop */
  while (1)
  {

  }
}

void SystemClock_Config(void)
{
  /* HSI configuration and activation */
  LL_RCC_HSI_Enable();
  while(LL_RCC_HSI_IsReady() != 1)
  {
  };

  /* Sysclk activation on the HSI */
  /* Set CPU1 prescaler*/
  LL_RCC_SetAHBPrescaler(LL_RCC_SYSCLK_DIV_1);

  /* Set CPU2 prescaler*/
  LL_C2_RCC_SetAHBPrescaler(LL_RCC_SYSCLK_DIV_2);

  LL_RCC_SetSysClkSource(LL_RCC_SYS_CLKSOURCE_HSI);
  while(LL_RCC_GetSysClkSource() != LL_RCC_SYS_CLKSOURCE_STATUS_HSI)
  {
  };

  /* Set AHB SHARED prescaler*/
  LL_RCC_SetAHB4Prescaler(LL_RCC_SYSCLK_DIV_1);

  /* Set APB1 prescaler*/
  LL_RCC_SetAPB1Prescaler(LL_RCC_APB1_DIV_1);

  /* Set APB2 prescaler*/
  LL_RCC_SetAPB2Prescaler(LL_RCC_APB2_DIV_1);

  LL_Init1msTick(16000000);

  /* Update CMSIS variable (which can be updated also through SystemCoreClockUpdate function) */
  LL_SetSystemCoreClock(16000000);
}

static void MX_GPIO_Init(void)
{
  LL_GPIO_InitTypeDef GPIO_InitStruct = {0};

  /* GPIO Ports Clock Enable */
  LL_AHB2_GRP1_EnableClock(LL_AHB2_GRP1_PERIPH_GPIOB);

  /**/
  LL_GPIO_ResetOutputPin(LED2_GPIO_Port, LED2_Pin);

  /**/
  GPIO_InitStruct.Pin = LED2_Pin;
  GPIO_InitStruct.Mode = LL_GPIO_MODE_OUTPUT;
  GPIO_InitStruct.Speed = LL_GPIO_SPEED_FREQ_LOW;
  GPIO_InitStruct.OutputType = LL_GPIO_OUTPUT_PUSHPULL;
  GPIO_InitStruct.Pull = LL_GPIO_PULL_NO;
  LL_GPIO_Init(LED2_GPIO_Port, &GPIO_InitStruct);

}

/* USER CODE BEGIN 4 */

/**
  * @brief  This function configures HSEM Instance.
  * @note   This function is used to :
  *         - Enable peripheral clock for HSEM.
  * @param  None
  * @retval None
  */
void Configure_HSEM(void)
{
  /* Enable peripheral clock for RNG */
  LL_AHB3_GRP1_EnableClock(LL_AHB3_GRP1_PERIPH_HSEM);
}

/**
  * @brief  Turn-on LED2.
  * @param  None
  * @retval None
  */
void LED_On(void)
{
  /* Turn LED2 on */
  LL_GPIO_SetOutputPin(LED2_GPIO_Port, LED2_Pin);
}

/**
  * @brief  Set LED2 to Blinking mode for an infinite loop (toggle period based on value provided as input parameter).
  * @param  Period : Period of time (in ms) between each toggling of LED
  *   This parameter can be user defined values. Pre-defined values used in that example are :
  *     @arg LED_BLINK_FAST : Fast Blinking
  *     @arg LED_BLINK_SLOW : Slow Blinking
  *     @arg LED_BLINK_ERROR : Error specific Blinking
  * @retval None
  */
void LED_Blinking(uint32_t Period)
{
  /* Toggle LED2 in an infinite loop */
  while (1)
  {
    LL_GPIO_TogglePin(LED2_GPIO_Port, LED2_Pin);
    LL_mDelay(Period);
  }
}

/* USER CODE END 4 */

void Error_Handler(void)
{
}

/************************ (C) COPYRIGHT STMicroelectronics *****END OF FILE****/
